# _50components: IP-XACT component
VLNV generated.local:uploaded.designs:_50components:1.0
Generated IP-XACT component description from 50components.json. Registers are auto-addressed at 0x4 increments; port directions are inferred as inout unless a common clock/reset/interrupt convention applies.

## Bus interfaces (logical=physical port)
APB_BUS:  generated.local:bus:APB_BUS:1.0
AHB_BUS:  generated.local:bus:AHB_BUS:1.0
AXI_BUS:  generated.local:bus:AXI_BUS:1.0

## Ports
in CPU0_clk
in CPU0_rst
out CPU0_irq
in CPU1_clk
in CPU1_rst
out CPU1_irq
out UART{n}_tx (n=0..3)
in UART{n}_rx (n=0..3)
out SPI{n}_mosi (n=0..2)
in SPI{n}_miso (n=0..2)
in SPI{n}_sclk (n=0..2)
out SPI{n}_cs (n=0..2)
inout I2C{n}_sda (n=0..2)
in I2C{n}_scl (n=0..2)
inout GPIO{n}_in (n=0..3)
out GPIO{n}_out (n=0..3)
in TIMER{n}_clk (n=0..2)
out TIMER{n}_irq (n=0..2)
in DMA0_req
out DMA0_ack
in DMA1_req
out DMA1_ack
in ADC0_analog_in
in ADC1_analog_in
out DAC0_analog_out
out DAC1_analog_out
out PWM{n}_pwm_out (n=0..2)
out ETH0_tx
in ETH0_rx
out ETH1_tx
in ETH1_rx
out CAN0_tx
in CAN0_rx
out CAN1_tx
in CAN1_rx
in USB0_dp
in USB0_dm
in USB1_dp
in USB1_dm
in CACHE_L1_addr
in CACHE_L1_data
in CACHE_L2_addr
in CACHE_L2_data
in SRAM0_addr
in SRAM0_data
out SRAM0_we
in SRAM1_addr
in SRAM1_data
out SRAM1_we
in FLASH0_addr
in FLASH0_data
out FLASH0_we
in DDR0_addr
in DDR0_data
in GPU0_clk
in GPU0_rst
in NPU0_clk
in NPU0_rst
in RTC_clk
out RTC_alarm
in WATCHDOG_clk
in INTC_irq_in
out INTC_irq_out
in APB_BUS_paddr
in APB_BUS_pwdata
out APB_BUS_prdata
in AHB_BUS_haddr
in AHB_BUS_hwdata
out AHB_BUS_hrdata
in AXI_BUS_awaddr
in AXI_BUS_wdata
out AXI_BUS_rdata

## Address spaces and blocks
CPU0_memoryMap.CPU0_registers: base 0x0, range 0xc, width 32
CPU1_memoryMap.CPU1_registers: base 0x1000, range 0xc, width 32
UART0_memoryMap.UART0_registers: base 0x2000, range 0xc, width 32
UART1_memoryMap.UART1_registers: base 0x3000, range 0xc, width 32
UART2_memoryMap.UART2_registers: base 0x4000, range 0xc, width 32
UART3_memoryMap.UART3_registers: base 0x5000, range 0xc, width 32
SPI0_memoryMap.SPI0_registers: base 0x6000, range 0xc, width 32
SPI1_memoryMap.SPI1_registers: base 0x7000, range 0xc, width 32
SPI2_memoryMap.SPI2_registers: base 0x8000, range 0xc, width 32
I2C0_memoryMap.I2C0_registers: base 0x9000, range 0xc, width 32
I2C1_memoryMap.I2C1_registers: base 0xa000, range 0xc, width 32
I2C2_memoryMap.I2C2_registers: base 0xb000, range 0xc, width 32
GPIO0_memoryMap.GPIO0_registers: base 0xc000, range 0xc, width 32
GPIO1_memoryMap.GPIO1_registers: base 0xd000, range 0xc, width 32
GPIO2_memoryMap.GPIO2_registers: base 0xe000, range 0xc, width 32
GPIO3_memoryMap.GPIO3_registers: base 0xf000, range 0xc, width 32
TIMER0_memoryMap.TIMER0_registers: base 0x10000, range 0xc, width 32
TIMER1_memoryMap.TIMER1_registers: base 0x11000, range 0xc, width 32
TIMER2_memoryMap.TIMER2_registers: base 0x12000, range 0xc, width 32
DMA0_memoryMap.DMA0_registers: base 0x13000, range 0xc, width 32
DMA1_memoryMap.DMA1_registers: base 0x14000, range 0xc, width 32
ADC0_memoryMap.ADC0_registers: base 0x15000, range 0x8, width 32
ADC1_memoryMap.ADC1_registers: base 0x16000, range 0x8, width 32
DAC0_memoryMap.DAC0_registers: base 0x17000, range 0x8, width 32
DAC1_memoryMap.DAC1_registers: base 0x18000, range 0x8, width 32
PWM0_memoryMap.PWM0_registers: base 0x19000, range 0x8, width 32
PWM1_memoryMap.PWM1_registers: base 0x1a000, range 0x8, width 32
PWM2_memoryMap.PWM2_registers: base 0x1b000, range 0x8, width 32
ETH0_memoryMap.ETH0_registers: base 0x1c000, range 0x8, width 32
ETH1_memoryMap.ETH1_registers: base 0x1d000, range 0x8, width 32
CAN0_memoryMap.CAN0_registers: base 0x1e000, range 0x8, width 32
CAN1_memoryMap.CAN1_registers: base 0x1f000, range 0x8, width 32
USB0_memoryMap.USB0_registers: base 0x20000, range 0x8, width 32
USB1_memoryMap.USB1_registers: base 0x21000, range 0x8, width 32
CACHE_L1_memoryMap.CACHE_L1_registers: base 0x22000, range 0x4, width 32
CACHE_L2_memoryMap.CACHE_L2_registers: base 0x23000, range 0x4, width 32
SRAM0_memoryMap.SRAM0_registers: base 0x24000, range 0x4, width 32
SRAM1_memoryMap.SRAM1_registers: base 0x25000, range 0x4, width 32
FLASH0_memoryMap.FLASH0_registers: base 0x26000, range 0x8, width 32
DDR0_memoryMap.DDR0_registers: base 0x27000, range 0x8, width 32
GPU0_memoryMap.GPU0_registers: base 0x28000, range 0x8, width 32
NPU0_memoryMap.NPU0_registers: base 0x29000, range 0x8, width 32
RTC_memoryMap.RTC_registers: base 0x2a000, range 0x8, width 32
WATCHDOG_memoryMap.WATCHDOG_registers: base 0x2b000, range 0x8, width 32
INTC_memoryMap.INTC_registers: base 0x2c000, range 0x8, width 32

## Registers
Registers are 32-bit, read-write, no defined reset value unless marked. A register's access mark holds for its fields unless they carry their own. Offsets are from the block's base; lines under a group give offsets from that group; [hi:lo] are bit positions; {n}, {i} and the like mark numbered series; 'fields as' and 'values as' point back to an identical list; <NAME> marks a mode.

## CPU0_memoryMap.CPU0_registers
Base 0x00000000
Same registers: CPU1_memoryMap.CPU1_registers 0x00001000
0x00 PC
0x04 CTRL
0x08 STATUS

## UART0_memoryMap.UART0_registers
Base 0x00002000
Same registers: UART1_memoryMap.UART1_registers 0x00003000, UART2_memoryMap.UART2_registers 0x00004000, UART3_memoryMap.UART3_registers 0x00005000
0x00 CTRL
0x04 STATUS
0x08 BAUD

## SPI0_memoryMap.SPI0_registers
Base 0x00006000
Same registers: SPI1_memoryMap.SPI1_registers 0x00007000, SPI2_memoryMap.SPI2_registers 0x00008000
0x00 CTRL
0x04 STATUS
0x08 DATA

## I2C0_memoryMap.I2C0_registers
Base 0x00009000
Same registers: I2C1_memoryMap.I2C1_registers 0x0000A000, I2C2_memoryMap.I2C2_registers 0x0000B000
0x00 CTRL
0x04 STATUS
0x08 ADDR

## GPIO0_memoryMap.GPIO0_registers
Base 0x0000C000
Same registers: GPIO1_memoryMap.GPIO1_registers 0x0000D000, GPIO2_memoryMap.GPIO2_registers 0x0000E000, GPIO3_memoryMap.GPIO3_registers 0x0000F000
0x00 DIR
0x04 DATA
0x08 INT

## TIMER0_memoryMap.TIMER0_registers
Base 0x00010000
Same registers: TIMER1_memoryMap.TIMER1_registers 0x00011000, TIMER2_memoryMap.TIMER2_registers 0x00012000
0x00 COUNT
0x04 COMPARE
0x08 CTRL

## DMA0_memoryMap.DMA0_registers
Base 0x00013000
Same registers: DMA1_memoryMap.DMA1_registers 0x00014000
0x00 SRC
0x04 DST
0x08 SIZE

## ADC0_memoryMap.ADC0_registers
Base 0x00015000
Same registers: ADC1_memoryMap.ADC1_registers 0x00016000
0x00 CTRL
0x04 RESULT

## DAC0_memoryMap.DAC0_registers
Base 0x00017000
Same registers: DAC1_memoryMap.DAC1_registers 0x00018000
0x00 CTRL
0x04 VALUE

## PWM0_memoryMap.PWM0_registers
Base 0x00019000
Same registers: PWM1_memoryMap.PWM1_registers 0x0001A000, PWM2_memoryMap.PWM2_registers 0x0001B000
0x00 DUTY
0x04 PERIOD

## ETH0_memoryMap.ETH0_registers
Base 0x0001C000
Same registers: ETH1_memoryMap.ETH1_registers 0x0001D000
0x00 MAC
0x04 STATUS

## CAN0_memoryMap.CAN0_registers
Base 0x0001E000
Same registers: CAN1_memoryMap.CAN1_registers 0x0001F000
0x00 CTRL
0x04 FILTER

## USB0_memoryMap.USB0_registers
Base 0x00020000
Same registers: USB1_memoryMap.USB1_registers 0x00021000, GPU0_memoryMap.GPU0_registers 0x00028000, NPU0_memoryMap.NPU0_registers 0x00029000
0x00 CTRL
0x04 STATUS

## CACHE_L1_memoryMap.CACHE_L1_registers
Base 0x00022000
Same registers: CACHE_L2_memoryMap.CACHE_L2_registers 0x00023000, SRAM0_memoryMap.SRAM0_registers 0x00024000, SRAM1_memoryMap.SRAM1_registers 0x00025000
0x00 CFG

## FLASH0_memoryMap.FLASH0_registers
Base 0x00026000
0x00 CFG
0x04 STATUS

## DDR0_memoryMap.DDR0_registers
Base 0x00027000
0x00 CTRL
0x04 TIMING

## RTC_memoryMap.RTC_registers
Base 0x0002A000
0x00 TIME
0x04 DATE

## WATCHDOG_memoryMap.WATCHDOG_registers
Base 0x0002B000
0x00 COUNT
0x04 CTRL

## INTC_memoryMap.INTC_registers
Base 0x0002C000
0x00 MASK
0x04 PENDING
